&display {
    compatible = "solomon,ssd1306fb";
    height = <32>;
    width = <128>;
    segment-offset = <0>;
    page-offset = <0>;
    display-offset = <0>;
    rotation = <0>;
    i2c-address = <0x3C>;
    label = "OLED";
};
