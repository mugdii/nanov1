/ {
    chosen {
        zephyr,display = &display0;
    };

    display0: display@3c {
        compatible = "solomon,ssd1306fb";
        reg = <0x3c>;
        width = <128>;
        height = <32>;
        segment-offset = <0>;
        page-offset = <0>;
        display-offset = <0>;
        multiplex-ratio = <31>;
    };

    leds {
        compatible = "sk6812-strip";
        label = "LED_STRIP";
        gpios = <&gpio0 6 GPIO_ACTIVE_HIGH>;
        chain-length = <27>;
        color-order = "GRB";
    };
};
